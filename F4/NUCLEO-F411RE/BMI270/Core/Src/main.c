/* USER CODE BEGIN Header */
/**
  ******************************************************************************
  * @file           : main.c
  * @brief          : Main program body
  ******************************************************************************
  * @attention
  *
  * Copyright (c) 2026 STMicroelectronics.
  * All rights reserved.
  *
  * This software is licensed under terms that can be found in the LICENSE file
  * in the root directory of this software component.
  * If no LICENSE file comes with this software, it is provided AS-IS.
  *
  ******************************************************************************
  */
/* USER CODE END Header */
/* Includes ------------------------------------------------------------------*/
#include "main.h"
#include "dma.h"
#include "i2c.h"
#include "rtc.h"
#include "spi.h"
#include "tim.h"
#include "usart.h"
#include "gpio.h"

/* Private includes ----------------------------------------------------------*/
/* USER CODE BEGIN Includes */
#include <stdio.h>
/* USER CODE END Includes */

/* Private typedef -----------------------------------------------------------*/
/* USER CODE BEGIN PTD */

/* USER CODE END PTD */

/* Private define ------------------------------------------------------------*/
/* USER CODE BEGIN PD */

/* USER CODE END PD */

/* Private macro -------------------------------------------------------------*/
/* USER CODE BEGIN PM */

/* USER CODE END PM */

/* Private variables ---------------------------------------------------------*/

/* USER CODE BEGIN PV */
uint8_t Buffer[25] = {0};
uint8_t temp[50];
uint8_t Space[] = " -- ";
uint8_t NewLine[] = "\r\n";
uint8_t StartMSG[] = "Starting I2C Scanning: \r\n";
uint8_t EndMSG[] = "\r\n ------ Done! ----- \r\n\r\n";
uint8_t i2c_address;

uint8_t bmi270_Config_File[8192] = {
    0xc8, 0x2e, 0x00, 0x2e, 0x80, 0x2e, 0x3d, 0xb1, 0xc8, 0x2e, 0x00, 0x2e, 0x80, 0x2e, 0x91, 0x03, 0x80, 0x2e, 0xbc,
    0xb0, 0x80, 0x2e, 0xa3, 0x03, 0xc8, 0x2e, 0x00, 0x2e, 0x80, 0x2e, 0x00, 0xb0, 0x50, 0x30, 0x21, 0x2e, 0x59, 0xf5,
    0x10, 0x30, 0x21, 0x2e, 0x6a, 0xf5, 0x80, 0x2e, 0x3b, 0x03, 0x00, 0x00, 0x00, 0x00, 0x08, 0x19, 0x01, 0x00, 0x22,
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    0x2e, 0x00, 0xc1
};

/* USER CODE END PV */

/* Private function prototypes -----------------------------------------------*/
void SystemClock_Config(void);
/* USER CODE BEGIN PFP */
void BMI270_I2C_init();
void BMI270_I2C_process();
int I2C1_byteRead(char saddr, char maddr, uint8_t* data);
int I2C1_byteWrite(char saddr, char maddr, uint8_t* data);
int I2C1_burstRead(char saddr, char maddr, int n, uint8_t* data);
int I2C1_burstWrite(char saddr, char maddr, int n, uint8_t* data);

void BMI270_SPI_init();
void BMI270_SPI_process();
void SPI1_transmit(uint8_t *data, uint32_t size);
void SPI1_receive(uint8_t *data, uint32_t size);
/* USER CODE END PFP */

/* Private user code ---------------------------------------------------------*/
/* USER CODE BEGIN 0 */
#ifdef __GNUC__
#define PUTCHAR_PROTOTYPE int __io_putchar(int ch)
#else
#define PUTCHAR_PROTOTYPE int fputc(int ch, FILE *f)
#endif

PUTCHAR_PROTOTYPE
{
	HAL_UART_Transmit(&huart2, (uint8_t*)&ch, 1, HAL_MAX_DELAY);
	return ch;
}
/* USER CODE END 0 */

/**
  * @brief  The application entry point.
  * @retval int
  */
int main(void)
{

  /* USER CODE BEGIN 1 */
	// определяем где выполняется программа, и корректируем расположение
	// таблицы векторов
	uint32_t retPCasm(void); // небольшая функция для определения где
	// выполняется программа в FLASH или RAM
	if ((retPCasm() & 0x20000000) != 0)
	{
		*((uint32_t *)0xe000ed08) = 0x20000000; /* FlagDebugInRAM=1;*/
	}
  /* USER CODE END 1 */

  /* MCU Configuration--------------------------------------------------------*/

  /* Reset of all peripherals, Initializes the Flash interface and the Systick. */
  HAL_Init();

  /* USER CODE BEGIN Init */

  /* USER CODE END Init */

  /* Configure the system clock */
  SystemClock_Config();

  /* USER CODE BEGIN SysInit */

  /* USER CODE END SysInit */

  /* Initialize all configured peripherals */
  MX_GPIO_Init();
  MX_DMA_Init();
  MX_SPI1_Init();
  MX_TIM5_Init();
  MX_RTC_Init();
  MX_I2C1_Init();
  MX_USART2_UART_Init();
  /* USER CODE BEGIN 2 */

  /* USER CODE END 2 */

  /* Infinite loop */
  /* USER CODE BEGIN WHILE */

	HAL_Delay(1000);
//	BMI270_I2C_init();
	BMI270_SPI_init();

  void main_BMI270(void);
  main_BMI270();
  while (1)
  {
//	  BMI270_I2C_process();
	  BMI270_SPI_process();
    /* USER CODE END WHILE */

    /* USER CODE BEGIN 3 */
  }
  /* USER CODE END 3 */
}

/**
  * @brief System Clock Configuration
  * @retval None
  */
void SystemClock_Config(void)
{
  RCC_OscInitTypeDef RCC_OscInitStruct = {0};
  RCC_ClkInitTypeDef RCC_ClkInitStruct = {0};

  /** Configure the main internal regulator output voltage
  */
  __HAL_RCC_PWR_CLK_ENABLE();
  __HAL_PWR_VOLTAGESCALING_CONFIG(PWR_REGULATOR_VOLTAGE_SCALE1);

  /** Initializes the RCC Oscillators according to the specified parameters
  * in the RCC_OscInitTypeDef structure.
  */
  RCC_OscInitStruct.OscillatorType = RCC_OSCILLATORTYPE_HSI|RCC_OSCILLATORTYPE_LSE;
  RCC_OscInitStruct.LSEState = RCC_LSE_ON;
  RCC_OscInitStruct.HSIState = RCC_HSI_ON;
  RCC_OscInitStruct.HSICalibrationValue = RCC_HSICALIBRATION_DEFAULT;
  RCC_OscInitStruct.PLL.PLLState = RCC_PLL_ON;
  RCC_OscInitStruct.PLL.PLLSource = RCC_PLLSOURCE_HSI;
  RCC_OscInitStruct.PLL.PLLM = 8;
  RCC_OscInitStruct.PLL.PLLN = 100;
  RCC_OscInitStruct.PLL.PLLP = RCC_PLLP_DIV2;
  RCC_OscInitStruct.PLL.PLLQ = 4;
  if (HAL_RCC_OscConfig(&RCC_OscInitStruct) != HAL_OK)
  {
    Error_Handler();
  }

  /** Initializes the CPU, AHB and APB buses clocks
  */
  RCC_ClkInitStruct.ClockType = RCC_CLOCKTYPE_HCLK|RCC_CLOCKTYPE_SYSCLK
                              |RCC_CLOCKTYPE_PCLK1|RCC_CLOCKTYPE_PCLK2;
  RCC_ClkInitStruct.SYSCLKSource = RCC_SYSCLKSOURCE_PLLCLK;
  RCC_ClkInitStruct.AHBCLKDivider = RCC_SYSCLK_DIV1;
  RCC_ClkInitStruct.APB1CLKDivider = RCC_HCLK_DIV2;
  RCC_ClkInitStruct.APB2CLKDivider = RCC_HCLK_DIV1;

  if (HAL_RCC_ClockConfig(&RCC_ClkInitStruct, FLASH_LATENCY_3) != HAL_OK)
  {
    Error_Handler();
  }
}

/* USER CODE BEGIN 4 */

void BMI270_I2C_init()
{
	HAL_GPIO_WritePin(SDO_GPIO_Port, SDO_Pin, GPIO_PIN_RESET);
	/*-[ I2C Bus Scanning ]-*/
	uint8_t i = 0, ret;
	printf("%s", StartMSG);
	printf("%s", Space);
    for (i = 1; i < 128; ++i)
    {
        if (i % 16 == 0)
        {
        	printf("%s", NewLine);
        }
        ret = HAL_I2C_IsDeviceReady(&hi2c1, (uint16_t)(i<<1), 3, 5);
        if (ret != HAL_OK) /* No ACK Received At That Address */
        {
        	printf("%s", Space);
        }
        else if(ret == HAL_OK)
        {
            printf("0x%X", i);
            if (i == 0x68 || i == 0x69) // MPU-6050, BMI270
            {
          	  i2c_address = i;
            }
            if (i == 0x53 || i == 0x1D) // ADXL345
            {
          	  i2c_address = i;
            }
        }
    }
    printf("%s", EndMSG);
    /*--[ Scanning Done ]--*/
    uint8_t chip_address;
    I2C1_byteRead(i2c_address, 0x00, &chip_address);
//    HAL_I2C_Mem_Read(&hi2c1, i2c_address << 1, 0x00, 1, &chip_address, 1, 100);
    printf("chip id: 0x%X\r\n", chip_address);

    // Soft reset
#define BMI_ADDRESS_RESET 		0x7E
#define BMI_VALUE_SOFT_RESET 	0xB6
    temp[0] = BMI_VALUE_SOFT_RESET;
    I2C1_byteWrite(i2c_address, BMI_ADDRESS_RESET, temp);
    HAL_Delay(10);

    // Write config file
#define BMI_ADDRESS_PWR_CONFIG 	0x7C
#define BMI_ADDRESS_INIT_CTRL 	0x59
#define BMI_ADDRESS_INIT_DATA 	0x5E
    temp[0] = 0x00; // value to disbale pwr save
    I2C1_byteWrite(i2c_address, BMI_ADDRESS_PWR_CONFIG, temp);
    HAL_Delay(1);
    // Prepare for loading
    I2C1_byteWrite(i2c_address, BMI_ADDRESS_INIT_CTRL, temp);
	// Write the whole thing
	I2C1_burstWrite(i2c_address, BMI_ADDRESS_INIT_DATA, 8192, bmi270_Config_File);
	// Finish loading
	temp[0] = 0x01;
	I2C1_byteWrite(i2c_address, BMI_ADDRESS_INIT_CTRL, temp);
	HAL_Delay(20);

	// Verify it worked
#define BMI_ADDRESS_INIT_STATUS 0x21
	I2C1_byteRead(i2c_address, BMI_ADDRESS_INIT_STATUS, temp);
	if (temp[0] != 0x01)
	{
		printf("ERROR CONFIG\r\n");
	}

	// Set normal power mode
#define BMI_ADDRESS_PWR_CTRL 	0x7D
#define BMI_VALUE_PWR_CTRL		0x0E
	temp[0] = BMI_VALUE_PWR_CTRL;
	I2C1_byteWrite(i2c_address, BMI_ADDRESS_PWR_CTRL, temp);

#define BMI_ADDRESS_ACC_CONF 	0x40
#define BMI_ADDRESS_GYR_CONF 	0x42
#define BMI_VALUE_ACC_CONF 		0xA8
#define BMI_VALUE_GYR_CONF 		0xA9
	temp[0] = BMI_VALUE_ACC_CONF;
	I2C1_byteWrite(i2c_address, BMI_ADDRESS_ACC_CONF, temp);
	temp[0] = BMI_VALUE_GYR_CONF;
	I2C1_byteWrite(i2c_address, BMI_ADDRESS_GYR_CONF, temp);

#define BMI_VALUE_PWR_CONF_DISABLE 0x02
	temp[0] = BMI_VALUE_PWR_CONF_DISABLE;
	I2C1_byteWrite(i2c_address, BMI_ADDRESS_PWR_CONFIG, temp);

	printf("BMI270 is configured\r\n");
}

void BMI270_I2C_process()
{
#define BMI_ADDRESS_SENS_BEGN 	0x0C
	uint16_t ax;
	uint16_t ay;
	uint16_t az;
	uint16_t gx;
	uint16_t gy;
	uint16_t gz;

	I2C1_burstRead(i2c_address, BMI_ADDRESS_SENS_BEGN, 12, temp);
	// accelerometer
	ax = (temp[1]<<8) | (temp[0]);
	ay = (temp[3]<<8) | (temp[2]);
	az = (temp[5]<<8) | (temp[4]);
	// gyro
	gx = (temp[7]<<8)  | (temp[6]);
	gy = (temp[9]<<8)  | (temp[8]);
	gz = (temp[11]<<8) | (temp[10]);
	printf("Accel: x = %d, y = %d, z = %d\r\n", ax, ay, az);
	printf("Gyro: x = %d, y = %d, z = %d\r\n", gx, gy, gz);

	HAL_Delay(100);
}

void BMI270_SPI_init()
{
    uint8_t dummy = 0x00;
    uint8_t chip_address;
    uint8_t data[2];
    data[0] = 0x00;
    HAL_GPIO_WritePin(BMI270_CS_GPIO_Port, BMI270_CS_Pin, GPIO_PIN_RESET);
    SPI1_transmit(&dummy, 1);
    SPI1_transmit(data, 1);
    SPI1_receive(&chip_address, 1);
    HAL_GPIO_WritePin(BMI270_CS_GPIO_Port, BMI270_CS_Pin, GPIO_PIN_SET);
    printf("chip id: 0x%X\r\n", chip_address);
}

void BMI270_SPI_process()
{
	printf("process\r\n");
	HAL_Delay(1000);
	return;
#define BMI_ADDRESS_SENS_BEGN 	0x0C
	uint16_t ax;
	uint16_t ay;
	uint16_t az;
	uint16_t gx;
	uint16_t gy;
	uint16_t gz;

//	I2C1_burstRead(i2c_address, BMI_ADDRESS_SENS_BEGN, 12, temp);
	SPI1_receive(temp, 12);
	// accelerometer
	ax = (temp[1]<<8) | (temp[0]);
	ay = (temp[3]<<8) | (temp[2]);
	az = (temp[5]<<8) | (temp[4]);
	// gyro
	gx = (temp[7]<<8)  | (temp[6]);
	gy = (temp[9]<<8)  | (temp[8]);
	gz = (temp[11]<<8) | (temp[10]);
	printf("Accel: x = %d, y = %d, z = %d\r\n", ax, ay, az);
	printf("Gyro: x = %d, y = %d, z = %d\r\n", gx, gy, gz);

	HAL_Delay(100);
}

// it works!
// https://github.com/ENG-EDISON/STM32_I2C1_I2C2_USART2_MPU6050_BareMetal
int I2C1_byteRead(char saddr, char maddr, uint8_t* data)
{
	volatile uint32_t tmp = 0;
	while (I2C1->SR2 & I2C_SR2_BUSY);       /* wait until bus not busy */
	I2C1->CR1 |= I2C_CR1_START;             /* generate start */
	while (!(I2C1->SR1 & I2C_SR1_SB));      /* wait until start flag is set */
	I2C1->DR = (uint8_t)saddr << 1;         /* transmit slave address + Write */
	while (!(I2C1->SR1 & I2C_SR1_ADDR));    /* wait until addr flag is set */
	tmp = I2C1->SR1;              			/* clear addr flag */
	tmp = I2C1->SR2;
	while (!(I2C1->SR1 & I2C_SR1_TXE));   	/* wait until data register empty */
	I2C1->DR = maddr;               		/* send memory address */
	while (!(I2C1->SR1 & I2C_SR1_TXE));    	/* wait until data register empty */
	I2C1->CR1 |= 0x100;             		/* generate restart */
	while (!(I2C1->SR1 & I2C_SR1_SB));      /* wait until start flag is set */
	I2C1->DR = (uint8_t)(saddr << 1 | 0x01);/* transmit slave address + Read */
	while (!(I2C1->SR1 & I2C_SR1_ADDR));    /* wait until addr flag is set */
	I2C1->CR1 &= ~I2C_CR1_ACK;            	/* Disable Acknowledge */
	tmp = I2C1->SR1;                		/* clear addr flag */
	tmp = I2C1->SR2;                		/* clear addr flag */
	while (!(I2C1->SR1 & I2C_SR1_RXNE));    /* Wait until RXNE flag is set */
	I2C1->CR1 |= I2C_CR1_STOP;            	/* generate stop after data received */
	*data++ = (uint8_t)I2C1->DR;            /* Read data from DR */
	return 0;
}

// it works!
// https://github.com/ENG-EDISON/STM32_I2C1_I2C2_USART2_MPU6050_BareMetal
int I2C1_byteWrite(char saddr, char maddr, uint8_t* data)
{
	volatile uint8_t tmp = 0;
	while (I2C1->SR2 & I2C_SR2_BUSY);       /* wait until bus not busy */
	I2C1->CR1 |= 0x100; 					/* generate start */
	while (!(I2C1->SR1 & 1));               /* wait until start flag is set */
	I2C1->DR = saddr << 1;                  /* transmit slave address */
	while(!(I2C1->SR1 & 2));                /* wait until addr flag is set */
	tmp = I2C1->SR2;                        /* clear addr flag */
	while (!(I2C1->SR1 & 0x80));            /* wait until data register empty */
	I2C1->DR = maddr;                       /* send memory address */
	while (!(I2C1->SR1 & 0x80));            /* wait until data register empty */
	I2C1->DR = *data;                       /* transmit data */
	while (!(I2C1->SR1 & 4));               /* wait until transfer finished */
	I2C1->CR1 |= 0x200;                     /* generate stop */
	return 0;
}

int I2C1_burstRead(char saddr, char maddr, int n, uint8_t* data)
{
	volatile uint32_t tmp = 0;
	while (I2C1->SR2 & I2C_SR2_BUSY);       /* wait until bus not busy */
	I2C1->CR1 |= I2C_CR1_START;             /* generate start */
	while (!(I2C1->SR1 & I2C_SR1_SB));      /* wait until start flag is set */
	I2C1->DR = (uint8_t)saddr << 1;         /* transmit slave address + Write */
	while (!(I2C1->SR1 & I2C_SR1_ADDR));    /* wait until addr flag is set */
	tmp = I2C1->SR1;              			/* clear addr flag */
	tmp = I2C1->SR2;
	while (!(I2C1->SR1 & I2C_SR1_TXE));   	/* wait until data register empty */
	I2C1->DR = maddr;               		/* send memory address */
	while (!(I2C1->SR1 & I2C_SR1_TXE));    	/* wait until data register empty */
	I2C1->CR1 |= 0x100;             		/* generate restart */
	while (!(I2C1->SR1 & I2C_SR1_SB));      /* wait until start flag is set */
	I2C1->DR = (uint8_t)(saddr << 1 | 0x01);/* transmit slave address + Read */
	while (!(I2C1->SR1 & I2C_SR1_ADDR));    /* wait until addr flag is set */
	tmp = I2C1->SR1;                		/* clear addr flag */
	tmp = I2C1->SR2;                		/* clear addr flag */
	I2C1->CR1 |= I2C_CR1_ACK;            	/* Enable Acknowledge */
	while (n > 0U)
	{
    	if (n == 1U)
    	{
    		I2C1->CR1 &= ~I2C_CR1_ACK;            	/* Disable Acknowledge */
    		tmp = I2C1->SR1;                		/* clear addr flag */
    		tmp = I2C1->SR2;                		/* clear addr flag */
    		while (!(I2C1->SR1 & I2C_SR1_RXNE));    /* Wait until RXNE flag is set */
    		I2C1->CR1 |= I2C_CR1_STOP;            	/* generate stop after data received */
    		*data++ = (uint8_t)I2C1->DR;            /* Read data from DR */
    		break;
    	}
    	else
    	{
    		while (!(I2C1->SR1 & I2C_SR1_RXNE));    /* Wait until RXNE flag is set */
    		*data++ = (uint8_t)I2C1->DR;            /* Read data from DR */
    		--n;
    	}
	}
	return 0;
}

int I2C1_burstWrite(char saddr, char maddr, int n, uint8_t* data)
{
	volatile uint8_t tmp = 0;
	while (I2C1->SR2 & I2C_SR2_BUSY);       /* wait until bus not busy */
	I2C1->CR1 |= 0x100; 					/* generate start */
	while (!(I2C1->SR1 & 1));               /* wait until start flag is set */
	I2C1->DR = saddr << 1;                  /* transmit slave address */
	while(!(I2C1->SR1 & 2));                /* wait until addr flag is set */
	tmp = I2C1->SR2;                        /*clear addr flag */
	while (!(I2C1->SR1 & 0x80));            /* wait until data register empty */
	I2C1->DR = maddr;                       /* send memory address */
    for (int i = 0; i < n; i++)
    {
    	while (!(I2C1->SR1 & 0x80));        /* wait until data register empty */
    	I2C1->DR = *data++;                 /* transmit data */
    }
	while (!(I2C1->SR1 & 4));               /* wait until transfer finished */
	I2C1->CR1 |= 0x200;                     /* generate stop */
	return 0;
}

void SPI1_transmit(uint8_t *data, uint32_t size)
{
    uint32_t i = 0;
    volatile uint8_t temp;

    while (i < size)
    {
        while (!(SPI1->SR & (SPI_SR_TXE))) {}   /* Wait until TXE is set */
        SPI1->DR = data[i];                 /* Write the data to the data register */
        i++;
    }
    while (!(SPI1->SR & (SPI_SR_TXE))) {}       /* Wait until TXE is set */
    while ((SPI1->SR & (SPI_SR_BSY))) {}        /* Wait for BUSY flag to reset */
    temp = SPI1->DR;                        /* Clear OVR flag */
    temp = SPI1->SR;
}

void SPI1_receive(uint8_t *data, uint32_t size)
{
    while (size)
    {
        SPI1->DR = 0;                       /* Send dummy data */
        while (!(SPI1->SR & (SPI_SR_RXNE))) {}  /* Wait for RXNE flag to be set */
        *data++ = (SPI1->DR);               /* Read data from data register */
        size--;
    }
}

/* USER CODE END 4 */

/**
  * @brief  This function is executed in case of error occurrence.
  * @retval None
  */
void Error_Handler(void)
{
  /* USER CODE BEGIN Error_Handler_Debug */
  /* User can add his own implementation to report the HAL error return state */
  __disable_irq();
  while (1)
  {
  }
  /* USER CODE END Error_Handler_Debug */
}
#ifdef USE_FULL_ASSERT
/**
  * @brief  Reports the name of the source file and the source line number
  *         where the assert_param error has occurred.
  * @param  file: pointer to the source file name
  * @param  line: assert_param error line source number
  * @retval None
  */
void assert_failed(uint8_t *file, uint32_t line)
{
  /* USER CODE BEGIN 6 */
  /* User can add his own implementation to report the file name and line number,
     ex: printf("Wrong parameters value: file %s on line %d\r\n", file, line) */
  /* USER CODE END 6 */
}
#endif /* USE_FULL_ASSERT */
